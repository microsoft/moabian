## fw/src/boards/arm/moab_hat/Kconfig.board
```kconfig
# Kconfig - MOAB Hat with STM32F030CCT MCU
#

config BOARD_MOAB_HAT
	bool "MOAB Hat Development Board"
	depends on SOC_STM32F415XX
```

## fw/src/boards/arm/moab_hat/Kconfig.defconfig
```kconfig
# Kconfig - MOAB Hat with STM32F030CCT MCU
#

if BOARD_MOAB_HAT

config BOARD
	default "moab_hat"

config USE_CODE_PARTITION
	default y

config UART_1
	default y

if SHELL
config UART_3
	default y
endif # SHELL

if I2C
config I2C_2
	default y

config I2C_STM32_INTERRUPT
	default y
endif # I2C

if PWM
config PWM_STM32_3
	default y
endif # PWM

if LVGL
config LVGL_LOG_LEVEL
    default 2

config LVGL_DISPLAY_DEV_NAME
	default "SH1106"

config LVGL_HOR_RES
	default 128

config LVGL_VER_RES
	default 32

config LVGL_VDB_SIZE
	default 100

config LVGL_DPI
	default 128

config LVGL_BITS_PER_PIXEL
	default 1

choice LVGL_COLOR_DEPTH
	default LVGL_COLOR_DEPTH_1
endchoice
endif


endif # BOARD_MOAB_HAT
```

## fw/src/boards/arm/moab_hat/moab_hat_defconfig
```kconfig
# Zephyr Kernel Configuration
CONFIG_ARM=y

# Platform Configuration
CONFIG_SOC_SERIES_STM32F4X=y
CONFIG_SOC_STM32F415XX=y
# 168MHz system clock
CONFIG_CORTEX_M_SYSTICK=y
CONFIG_SYS_CLOCK_HW_CYCLES_PER_SEC=168000000

# Enable MPU
CONFIG_ARM_MPU=y

# Pinmux Driver
CONFIG_PINMUX=y

# GPIO Controller
CONFIG_GPIO=y

# Clock configuration
CONFIG_CLOCK_CONTROL=y

# Clock configuration for Cube Clock control driver
CONFIG_CLOCK_STM32_HSE_CLOCK=8000000
CONFIG_CLOCK_STM32_SYSCLK_SRC_PLL=y
# use HSE as PLL input
CONFIG_CLOCK_STM32_PLL_SRC_HSE=y
# produce 168MHz clock at PLL output
CONFIG_CLOCK_STM32_PLL_M_DIVISOR=8
CONFIG_CLOCK_STM32_PLL_N_MULTIPLIER=336
CONFIG_CLOCK_STM32_PLL_P_DIVISOR=2
CONFIG_CLOCK_STM32_PLL_Q_DIVISOR=7
CONFIG_CLOCK_STM32_AHB_PRESCALER=1
CONFIG_CLOCK_STM32_APB1_PRESCALER=4
CONFIG_CLOCK_STM32_APB2_PRESCALER=2
```

## fw/src/dts/bindings/sino,sh1106-spi.yaml
```yaml
title: SH1106 128x64 Dot Matrix Display Controller

description: |
    This is a representation of the SH1106 132x64 Dot Matrix Display Controller,
    accessed through SPI bus

compatible: "sino,sh1106"

include: spi-device.yaml

properties:
    height:
      type: int
      required: true
      description: Height in pixel of the panel driven by the controller

    width:
      type: int
      required: true
      description: Width in pixel of the panel driven by the controller

    segment-offset:
      type: int
      required: true
      description: 8-bit column start address for Page Addressing Mode

    page-offset:
      type: int
      required: true
      description: Start address for Page Addressing Mode

    display-offset:
      type: int
      required: true
      description: mapping of the display start line to one of COM0 .. COM63

    multiplex-ratio:
      type: int
      required: true
      description: Multiplex Ratio

    segment-remap:
      type: boolean
      required: false
      description: Last column address is mapped to first segment

    com-invdir:
      type: boolean
      required: false
      description: Scan direction is from last COM output to first COM output

    com-sequential:
      type: boolean
      required: false
      description: Sequential COM pin configuration

    prechargep:
      type: int
      required: true
      description: Duration of the pre-charge period

    reset-gpios:
      type: phandle-array
      required: true
      description: Reset pin

    a0-gpios:
      type: phandle-array
      required: false
      description: A0 pin (used in 4-wire mode)
```

## fw/src/dts/bindings/ti,lp50xx.yaml
```yaml
title: TI LP50xx LED Driver

description: TI LP50xx LED binding

compatible: "ti,lp50xx"

include: i2c-device.yaml

# Describes number of RGB LEDS supported by the specific chip
# example:  5018 is 6, 5024 is 8, 5030 is 10, and 5036 is 12
properties:
  rgb-count:
    type: int
    required: true

    
```
